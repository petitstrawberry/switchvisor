/dts-v1/;
/plugin/;

/ {
    fragment@0 {
        target-path = "/";
        __overlay__ {
            switchvisor-control {
                compatible = "switchvisor,control-v1";
                switchvisor,operator = <0>;
            };
        };
    };
};
